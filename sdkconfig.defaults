## sdkconfig.defaults
```kconfig
CONFIG_PARTITION_TABLE_SINGLE_APP=y
CONFIG_PARTITION_TABLE_OFFSET=0x8000
CONFIG_ESPTOOLPY_FLASHSIZE_4MB=y
CONFIG_ESPTOOLPY_BAUD_115200=y
CONFIG_ESP32C6_DEFAULT_CPU_FREQ_160=y
CONFIG_ESP32C6_FLASHMODE_DIO=y
```
